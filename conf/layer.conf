## conf/layer.conf
```bitbake
# We have a conf and classes directory, add to BBPATH
BBPATH .= ":${LAYERDIR}"

# We have recipes-* directories, add to BBFILES
BBFILES += " \
            ${LAYERDIR}/classes/*.bbclass \
            ${LAYERDIR}/recipes-*/*/*.bb \
            ${LAYERDIR}/recipes-*/*.bb \
            ${LAYERDIR}/recipes-*/*/*.bbappend \
            ${LAYERDIR}/recipes-*/*.bbappend \
            ${LAYERDIR}/recipes-*/*.bbappend \
            "

BBFILE_COLLECTIONS:append = " meta-mixin-python "
BBFILE_PATTERN_meta-mixin-python = "^${LAYERDIR}/"
BBFILE_PRIORITY_meta-mixin-python = "6"
LAYERVERSION_meta-mixin-python = "1"
LAYERSERIES_COMPAT_meta-mixin-python = "kirkstone"
```
